## meta-imx-bsp/conf/layer.conf
```bitbake
# We have a conf and classes directory, add to BBPATH
BBPATH .= ":${LAYERDIR}"

# We have a packages directory, add to BBFILES
BBFILES += "${LAYERDIR}/recipes-*/*/*.bb \
            ${LAYERDIR}/recipes-*/*/*.bbappend"

BBFILE_COLLECTIONS += "imx-frdm-release"
BBFILE_PATTERN_imx-frdm-release := "^${LAYERDIR}/"
BBFILE_PRIORITY_imx-frdm-release = "8"
LAYERSERIES_COMPAT_imx-frdm-release = "scarthgap"

# Overrides for imx93-11x11-lpddr4x-frdm.conf
MACHINE_FEATURES:append:imx93-11x11-lpddr4x-frdm = " dpdk nxpwifi-all-sdio"
MACHINE_FIRMWARE:append:imx93-11x11-lpddr4x-frdm = " ethos-u-firmware"
WKS_FILE_DEPENDS:append:imx93-11x11-lpddr4x-frdm = " imx-m33-demos"
IMAGE_BOOT_FILES:append:imx93-11x11-lpddr4x-frdm = " \
    imx93-11x11-evk_m33_TCM_power_mode_switch.bin \
    imx93-11x11-evk_m33_TCM_rpmsg_lite_pingpong_rtos_linux_remote.bin \
    imx93-11x11-evk_m33_TCM_rpmsg_lite_str_echo_rtos.bin \
"
IMXBOOT_TARGETS:imx93-11x11-lpddr4x-frdm = "${@bb.utils.contains('UBOOT_CONFIG', 'ecc', '${IMXBOOT_TARGETS_ECC}', '${IMXBOOT_TARGETS_SD}', d)}"
```

## meta-imx-bsp/conf/machine/imx8mp-lpddr4-frdm.conf
```bitbake
#@TYPE: Machine
#@NAME: NXP i.MX 8M Plus FRDM with LPDDR4
#@SOC: i.MX8MP
#@DESCRIPTION: Machine configuration for NXP i.MX 8M Plus FRDM with LPDDR4
#@MAINTAINER: Lei Xu <lei.xu@nxp.com>

require conf/machine/include/imx8mp-evk.inc

# The device tree name is implicit for LPDDR4, so can't use MACHINE here
KERNEL_DEVICETREE_BASENAME = "imx8mp-frdm"

# NXP kernel has additional DTB files for various board configuration and
# derivates. Include them here for NXP BSP only
KERNEL_DEVICETREE:append:use-nxp-bsp = " \
    freescale/${KERNEL_DEVICETREE_BASENAME}-8mic.dtb \
    freescale/${KERNEL_DEVICETREE_BASENAME}-boe-wxga-lvds0-panel.dtb \
    freescale/${KERNEL_DEVICETREE_BASENAME}-boe-wxga-lvds1-panel.dtb \
    freescale/${KERNEL_DEVICETREE_BASENAME}-dual-ap1302.dtb \
    freescale/${KERNEL_DEVICETREE_BASENAME}-dual-os08a20.dtb \
    freescale/${KERNEL_DEVICETREE_BASENAME}-os08a20.dtb \
    freescale/${KERNEL_DEVICETREE_BASENAME}-rpmsg.dtb \
    freescale/${KERNEL_DEVICETREE_BASENAME}-waveshare.dtb \
    freescale/${KERNEL_DEVICETREE_BASENAME}-iw612-otbr.dtb \
"

UBOOT_CONFIG_BASENAME = "imx8mp_frdm"
UBOOT_CONFIG[fspi] = "${UBOOT_CONFIG_BASENAME}_defconfig"

# Set DDR FIRMWARE
DDR_FIRMWARE_VERSION = "202006"
DDR_FIRMWARE_NAME = " \
    lpddr4_pmu_train_1d_dmem_${DDR_FIRMWARE_VERSION}.bin \
    lpddr4_pmu_train_1d_imem_${DDR_FIRMWARE_VERSION}.bin \
    lpddr4_pmu_train_2d_dmem_${DDR_FIRMWARE_VERSION}.bin \
    lpddr4_pmu_train_2d_imem_${DDR_FIRMWARE_VERSION}.bin \
"

IMXBOOT_TARGETS_BASENAME = "flash_evk"

# Mainline BSP doesn't support LPDDR4 so it must be set to nxp.
# Also this machine isn't supported by u-boot-fslc but imx8mn-evk.inc already
# set the bootloader to u-boot-imx instead when NXP BSP is used.
IMX_DEFAULT_BSP = "nxp"
```

## meta-imx-bsp/conf/machine/imx8mpfrdm.conf
```bitbake
#@TYPE: Machine
#@NAME: i.MX 8MP Consolidated Machine
#@DESCRIPTION: A consolidated machine configuration for i.MX 8MP FRDM LPDDR4, see Important Note below
#@MAINTAINER: Lei Xu <lei.xu@nxp.com>

#        ** Important Note **
# This machine generates an image contain the bootloader of LPDDR4 FRDM, Kernel, and rootfs, plus the DTBs of
# LPDDR4 FRDM. The resulting image can be used for LPDDR4 FRDM directly.

MACHINEOVERRIDES =. "imx8mp-lpddr4-frdm:"
require conf/machine/imx8mp-lpddr4-frdm.conf
```

## meta-imx-bsp/conf/machine/imx91frdm.conf
```bitbake
#@TYPE: Machine
#@NAME: i.MX 91 Consolidated rootfs machine
#@SOC: i.MX91
#@DESCRIPTION: A Consolidated machine configuration for i.MX 91 LPDDR4 FRDM, see Important Note below
#@MAINTAINER: Lei Xu <lei.xu@nxp.com>

#        ** Important Note **
# This machine generates an image contain the bootloader of 11x11 LPDDR4 FRDM, Kernel, and rootfs, DTBs.
# The resulting image can be used for 11x11 LPDDR4 FRDM directly,
# For most users, the dedicated machine imx91-11x11-lpddr4-frdm.conf should be used for simplicity.

MACHINEOVERRIDES =. "imx91-11x11-lpddr4-frdm:"
require conf/machine/imx91-11x11-lpddr4-frdm.conf
```

## meta-imx-bsp/conf/machine/imx91frdmimx91s.conf
```bitbake
#@TYPE: Machine
#@NAME: FRDM-IMX91S
#@SOC: IMX91
#@DESCRIPTION: A Consolidated machine configuration for FRDM-IMX91S, see Important Note below
#@MAINTAINER: Lei Xu <lei.xu@nxp.com>

#        ** Important Note **
# This machine generates images containing the bootloader of FRDM-IMX91S, Kernel, and rootfs, DTBs.
# The resulting image can be used for 11x11 LPDDR4 FRDM-IMX91S directly,
# For most users, the dedicated machine imx91-11x11-lpddr4-frdm-imx91s.conf should be used for simplicity.

MACHINEOVERRIDES =. "imx91-11x11-lpddr4-frdm-imx91s:"
require conf/machine/imx91-11x11-lpddr4-frdm-imx91s.conf
```

## meta-imx-sdk/conf/layer.conf
```bitbake
# We have a conf and classes directory, add to BBPATH
BBPATH .= ":${LAYERDIR}"

# We have a packages directory, add to BBFILES
BBFILES += "${LAYERDIR}/recipes-*/*/*.bb \
            ${LAYERDIR}/recipes-*/*/*.bbappend"

BBFILE_COLLECTIONS += "imx-frdm-sdk-release"
BBFILE_PATTERN_imx-frdm-sdk-release := "^${LAYERDIR}/"
BBFILE_PRIORITY_imx-frdm-sdk-release = "8"
LAYERSERIES_COMPAT_imx-frdm-sdk-release = "scarthgap"
```

## meta-nxp-connectivity/conf/layer.conf
```bitbake
# We have a conf and classes directory, add to BBPATH
BBPATH .= ":${LAYERDIR}"

# We have a packages directory, add to BBFILES
BBFILES += "${LAYERDIR}/recipes-*/*/*.bb \
            ${LAYERDIR}/recipes-*/*/*.bbappend"

BBFILE_COLLECTIONS += "imx-frdm-matter"
BBFILE_PATTERN_imx-frdm-matter := "^${LAYERDIR}/"
BBFILE_PRIORITY_imx-frdm-matter = "8"
LAYERSERIES_COMPAT_imx-frdm-matter = "scarthgap"
```

## meta-nxp-connectivity/conf/machine/imx8mpfrdm-matter.conf
```bitbake
#@TYPE: Machine
#@NAME: i.MX 8MP Consolidated Machine For Matter
#@DESCRIPTION: A consolidated machine for i.MX 8MP LPDDR4 FRDM Matter demos
#@MAINTAINER: Lei Xu <lei.xu@nxp.com>

MACHINEOVERRIDES =. "imx8mp-lpddr4-frdm:"
require conf/machine/imx8mp-lpddr4-frdm.conf

DELTA_KERNEL_DEFCONFIG="${WORKDIR}/kernel-config/*"
IMAGE_INSTALL:append = " packagegroup-nxp-matter-baseline packagegroup-nxp-openthread packagegroup-nxp-otbr packagegroup-nxp-zigbee-rcp "

UBOOT_DELTA_CONFIG="${WORKDIR}/uboot-config/*"
```

## meta-nxp-connectivity/conf/machine/imx91frdm-iwxxx-matter.conf
```bitbake
#@TYPE: Machine
#@NAME: A consolidated IW610 MATTER machine for i.MX 91 FRDM
#@SOC: i.MX91
#@MAINTAINER: Lei Xu <lei.xu@nxp.com>

MACHINEOVERRIDES =. "imx91-11x11-lpddr4-frdm:"
require conf/machine/imx91-11x11-lpddr4-frdm.conf

DELTA_KERNEL_DEFCONFIG="${WORKDIR}/kernel-config/*"

UBOOT_DELTA_CONFIG="${WORKDIR}/uboot-config/*"

IMAGE_INSTALL:append = " packagegroup-nxp-matter-baseline packagegroup-nxp-openthread packagegroup-nxp-otbr "
```

## meta-nxp-connectivity/conf/machine/imx91frdmimx91s-iwxxx-matter.conf
```bitbake
#@TYPE: Machine
#@NAME: A consolidated IW610 MATTER machine for FRDM-IMX91S
#@SOC: IMX91
#@MAINTAINER: Lei Xu <lei.xu@nxp.com>

MACHINEOVERRIDES =. "imx91-11x11-lpddr4-frdm-imx91s:"
require conf/machine/imx91-11x11-lpddr4-frdm-imx91s.conf

DELTA_KERNEL_DEFCONFIG="${WORKDIR}/kernel-config/*"

UBOOT_DELTA_CONFIG="${WORKDIR}/uboot-config/*"

IMAGE_INSTALL:append = " packagegroup-nxp-matter-baseline packagegroup-nxp-openthread packagegroup-nxp-otbr "
```

## meta-nxp-demo-experience/conf/layer.conf
```bitbake
# We have a conf and classes directory, append to BBPATH
BBPATH .= ":${LAYERDIR}"

# We have a recipes directory, add to BBFILES
BBFILES += "${LAYERDIR}/recipes-*/*/*.bb \
            ${LAYERDIR}/recipes-*/*/*.bbappend"

BBFILE_COLLECTIONS += "imx-frdm-demo"
BBFILE_PATTERN_imx-frdm-demo := "^${LAYERDIR}/"
BBFILE_PRIORITY_imx-frdm-demo = "7"

LAYERSERIES_COMPAT_imx-frdm-demo = "scarthgap"

GPNT_APPS_FOLDER ?= "/opt/gopoint-apps"
```
